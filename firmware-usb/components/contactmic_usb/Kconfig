## firmware-usb/components/contactmic_usb/Kconfig
```kconfig
menu "ContactMic USB microphone"
config CONTACTMIC_USB_AUTO_CEILING
    int "USB-only AUTO bootstrap ceiling (0=safe, 1=medium, 2=high)"
    range 0 2
    default 0
    help
        This is not a physical qualification result. Fixed modes remain available
        through CDC. USB-specific production defaults require CM-009 hardware evidence.
endmenu
```

## firmware-usb/sdkconfig.defaults
```kconfig
CONFIG_BT_ENABLED=n
CONFIG_ESP_WIFI_ENABLED=n
CONFIG_ESP_CONSOLE_NONE=y
CONFIG_ESP_CONSOLE_SECONDARY_NONE=y
CONFIG_FREERTOS_HZ=1000
CONFIG_ESP_DEFAULT_CPU_FREQ_MHZ_240=y
CONFIG_PM_ENABLE=n
CONFIG_COMPILER_OPTIMIZATION_PERF=y
CONFIG_CONTACTMIC_USB_AUTO_CEILING=0
```

## firmware/components/contactmic_session/Kconfig
```kconfig
menu "ContactMic integration"
config CONTACTMIC_AUTO_CEILING
    int "Unqualified AUTO bootstrap ceiling (0=safe, 1=medium, 2=high)"
    range 0 2
    default 0
    help
        Safe is the conservative pre-hardware bootstrap, not a qualified
        production default. Raise this ceiling only for explicit candidate
        testing. Runtime fault/capacity downshifts persist until reboot.
        CM-007 must select production defaults from physical evidence.
endmenu
```

## firmware/sdkconfig.defaults
```kconfig
CONFIG_IDF_TARGET="esp32s3"
CONFIG_BT_ENABLED=y
# CONFIG_BT_BLUEDROID_ENABLED is not set
CONFIG_BT_NIMBLE_ENABLED=y
CONFIG_BT_NIMBLE_MAX_CONNECTIONS=1
CONFIG_BT_NIMBLE_ATT_PREFERRED_MTU=247
# CONFIG_SPIRAM is not set
```
